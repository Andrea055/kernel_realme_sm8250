## drivers/soc/oplus/thermal/detection/Kconfig
```kconfig
config OPLUS_FEATURE_ATD
	tristate "abnormal_detection"
	default y
	help
	  abnormal thread detection
```

## drivers/soc/oplus/thermal/oplus_omrg/Kconfig
```kconfig
config OPLUS_OMRG
  tristate "oplus multiple rail group"
  default y
  help
    manager frequency dependency caused by multiple rail between
    different cpufreq device and devfreq device
```

## include/linux/fs/Kconfig
```kconfig
#ifdef OPLUS_FEATURE_HEALTHINFO
config FG_TASK_UID
	bool "Enable /proc/fg_info/ if EXPERT"
	default y
	help
	  Add foreground process optimize support to promote performance .
#endif
```
